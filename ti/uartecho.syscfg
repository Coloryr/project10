/**
 * @cliArgs --board "/ti/boards/MSP_EXP432E401Y" --product "simplelink_msp432e4_sdk@4.20.00.12"
 * @versions {"tool":"1.9.0+2015","templates":null}
 */

/**
 * Import the modules used in this configuration.
 */
const ADCBuf  = scripting.addModule("/ti/drivers/ADCBuf", {}, false);
const ADCBuf1 = ADCBuf.addInstance();
const GPIO    = scripting.addModule("/ti/drivers/GPIO");
const GPIO1   = GPIO.addInstance();
const RTOS    = scripting.addModule("/ti/drivers/RTOS");
const UART    = scripting.addModule("/ti/drivers/UART");
const UART1   = UART.addInstance();

/**
 * Write custom configuration values to the imported modules.
 */
ADCBuf1.$name                     = "CONFIG_ADCBUF_0";
ADCBuf1.sequencer0.$name          = "ti_drivers_adcbuf_ADCBufSeqMSP432E40";
ADCBuf1.sequencer0.channel0.$name = "ADCBUF_CHANNEL_0";

GPIO1.$hardware = system.deviceData.board.components.D1;
GPIO1.$name     = "CONFIG_GPIO_LED_0";


UART1.$name     = "CONFIG_UART_0";
UART1.$hardware = system.deviceData.board.components.XDS110UART;

/**
 * Pinmux solution for unlocked pins/peripherals. This ensures that minor changes to the automatic solver in a future
 * version of the tool will not impact the pinmux you originally saw.  These lines can be completely deleted in order to
 * re-solve from scratch.
 */
ADCBuf1.timer.$suggestSolution                      = "Timer1";
ADCBuf1.adc.$suggestSolution                        = "ADC0";
ADCBuf1.sequencer0.dmaChannel.$suggestSolution      = "UDMA_CH14";
ADCBuf1.sequencer0.channel0.adcPin.$suggestSolution = "boosterpack.26";
GPIO1.gpioPin.$suggestSolution                      = "expansion.87";
RTOS.timer0.resource.$suggestSolution               = "Timer0";
UART1.uart.$suggestSolution                         = "UART0";
UART1.uart.txPin.$suggestSolution                   = "expansion.76";
UART1.uart.rxPin.$suggestSolution                   = "expansion.74";
